## meta-ostro/conf/layer.conf
```bitbake
# We have a conf and classes directory, add to BBPATH. Add it at the
# front because we want to override files like fs-perms.txt.
BBPATH =. "${LAYERDIR}:"

# We have recipes-* directories, add to BBFILES
BBFILES += "${LAYERDIR}/recipes-*/*/*.bb \
	${LAYERDIR}/recipes-*/*/*.bbappend"

# Set a variable to get to the top of the metadata location
IMAGE_DSK_BASE := '${LAYERDIR}'

BBFILE_COLLECTIONS += "ostro"
BBFILE_PATTERN_ostro := "^${LAYERDIR}/"
BBFILE_PRIORITY_ostro = "6"
```

## meta-soletta/conf/distro/smallos.conf
```bitbake
require conf/distro/poky.conf

DISTRO = "smallos"
DISTRO_NAME = "SmallOS(Yocto based IoT Distro)"
DISTRO_VERSION = "0.1+snapshot-${DATE}"
DISTRO_CODENAME = "master"
hostname_pn-base-files = "Soletta SmallOS"

SDK_VENDOR = "-smallossdk"
SDK_VERSION := "${@'${DISTRO_VERSION}'.replace('snapshot-${DATE}','snapshot')}"
SDK_NAME = "${DISTRO}-${TCLIBC}-${SDK_ARCH}-${IMAGE_BASENAME}-${TUNE_PKGARCH}"

MAINTAINER = "Soletta Project <https://github.com/solettaproject/>"

TARGET_VENDOR = "-smallos"

LOCALCONF_VERSION = "1"

DISTRO_FEATURES_append = " systemd"
VIRTUAL-RUNTIME_init_manager = "systemd"
DISTRO_FEATURES_BACKFILL_CONSIDERED = "sysvinit"

EXTRA_IMAGE_FEATURES =+ " tools-sdk"
EXTRA_IMAGE_FEATURES =+ " ssh-server-openssh"

# Install avahi daemon for discovery
IMAGE_INSTALL =+ " avahi-daemon"

# Install Python modules
IMAGE_INSTALL_append = " python-dev python-numpy python-argparse python-subprocess"

# Libmicrohttpd
IMAGE_INSTALL_append = " libmicrohttpd"

# Configure networkd by default on smallos distro
PACKAGECONFIG_append_pn-systemd = " networkd microhttpd"

IMAGE_INSTALL_append = " \
     ${@bb.utils.contains('DISTRO_FEATURES','soletta-dev-app','nodejs','',d)} \
     ${@bb.utils.contains('DISTRO_FEATURES','soletta-dev-app','graphviz','',d)} \
     ${@bb.utils.contains('DISTRO_FEATURES','soletta-dev-app','git','',d)} \
     ${@bb.utils.contains('DISTRO_FEATURES','soletta-dev-app','soletta-dev-app','',d)} \
     ${@bb.utils.contains('DISTRO_FEATURES', 'python3-jsonschema', 'python3-jsonschema', '', d)} \
"
```

## meta-soletta/conf/layer.conf
```bitbake
BBPATH .= ":${LAYERDIR}"

BBFILES += "${LAYERDIR}/recipes-*/*/*.bb ${LAYERDIR}/recipes-*/*/*.bbappend"

BBFILE_COLLECTIONS += "soletta"
BBFILE_PATTERN_soletta = "^${LAYERDIR}/"
BBFILE_PRIORITY_soletta = "1"

LAYERVERSION_soletta = "1"
LAYERDEPENDS_soletta = "core"
```
