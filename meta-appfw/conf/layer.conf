## meta-intel/meta-emenlow/conf/machine/emenlow-noemgd.conf
```bitbake
#@TYPE: Machine
#@NAME: emenlow-noemgd

#@WEBTITLE: Intel Atom Z5xx Processor With Intel US15W Controller Hub (eMenlow) with open source graphics

#@DESCRIPTION: Machine configuration for eMenlow based systems, like the Webs-2120 box, without the Intel-proprietary graphics bits

PREFERRED_VERSION_linux-yocto ?= "3.17%"

require conf/machine/include/intel-core2-32-common.inc
require conf/machine/include/intel-common-pkgarch.inc
require conf/machine/include/meta-intel.inc

MACHINE_FEATURES += "intel-ucode"

XSERVER ?= "${XSERVER_X86_BASE} \
           ${XSERVER_X86_EXT} \
           ${XSERVER_X86_MODESETTING} \
           "
APPEND += "reboot=pci"
```
