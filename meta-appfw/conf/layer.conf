## meta-appfw/conf/layer.conf
```bitbake
BBPATH .= ":${LAYERDIR}"

BBFILES += "${LAYERDIR}/recipes-*/*/*.bb \
            ${LAYERDIR}/recipes-*/*/*.bbappend"

BBFILE_COLLECTIONS += "appfw"
BBFILE_PATTERN_appfw := "^${LAYERDIR}/"
BBFILE_PRIORITY_appfw = "6"
```

## meta-intel-iot-middleware/conf/layer.conf
```bitbake
# We have a conf and classes directory, add to BBPATH
BBPATH .= ":${LAYERDIR}"

# We have a recipes directory, add to BBFILES
BBFILES += "${LAYERDIR}/recipes-*/*/*.bb \
	${LAYERDIR}/recipes-*/*/*.bbappend"

BBFILE_COLLECTIONS += "intel-iot-mw"
BBFILE_PATTERN_intel-iot-mw := "^${LAYERDIR}/"
BBFILE_PRIORITY_intel-iot-mw = "8"
```

## meta-intel-iot-security/meta-integrity/conf/layer.conf
```bitbake
# We have a conf and classes directory, add to BBPATH
BBPATH =. "${LAYERDIR}:"

# We have a packages directory, add to BBFILES
BBFILES := "${BBFILES} \
            ${LAYERDIR}/recipes-*/*/*.bb \
            ${LAYERDIR}/recipes-*/*/*.bbappend"

BBFILE_COLLECTIONS += "integrity"
BBFILE_PATTERN_integrity := "^${LAYERDIR}/"
BBFILE_PRIORITY_integrity = "6"

# Set a variable to get to the top of the metadata location,
# needed for finding scripts and default debug keys.
IMA_EVM_BASE := '${LAYERDIR}'
export IMA_EVM_BASE
```

## meta-intel-iot-security/meta-security-framework/conf/layer.conf
```bitbake
# We have a conf and classes directory, add to BBPATH
BBPATH .= ":${LAYERDIR}"

# We have recipes-* directories, add to BBFILES
BBFILES += "${LAYERDIR}/recipes-*/*/*.bb \
	${LAYERDIR}/recipes-*/*/*.bbappend"

BBFILE_COLLECTIONS += "security-framework"
BBFILE_PATTERN_security-framework = "^${LAYERDIR}/"
BBFILE_PRIORITY_security-framework = "6"
```

## meta-intel-iot-security/meta-security-smack/conf/layer.conf
```bitbake
# We have a conf and classes directory, add to BBPATH
BBPATH =. "${LAYERDIR}:"

# We have a packages directory, add to BBFILES
BBFILES := "${BBFILES} \
            ${LAYERDIR}/recipes-*/*/*.bb \
            ${LAYERDIR}/recipes-*/*/*.bbappend"

# Must prioritize our rpm recipe over the default ones.
BBFILE_COLLECTIONS += "security-smack"
BBFILE_PATTERN_security-smack := "^${LAYERDIR}/"
BBFILE_PRIORITY_security-smack = "8"
```

## meta-intel/conf/layer.conf
```bitbake
# We have a conf and classes directory, add to BBPATH
BBPATH .= ":${LAYERDIR}:${LAYERDIR}/common"

# We have recipes-* directories, add to BBFILES
BBFILES += "${LAYERDIR}/common/recipes-*/*/*.bb \
            ${LAYERDIR}/common/recipes-*/*/*.bbappend"

BBFILE_COLLECTIONS += "intel"
BBFILE_PATTERN_intel := "^${LAYERDIR}/common/"
BBFILE_PRIORITY_intel = "5"

# Additional license directories.
LICENSE_PATH += "${LAYERDIR}/common/custom-licenses"

# This should only be incremented on significant changes that will
# cause compatibility issues with other layers
LAYERVERSION_intel = "3"


# Exclude RMC patches unless RMC Feature is eanbled
RMC_BBMASK := "${LAYERDIR}/common/recipes-bsp/systemd-boot/systemd-boot.*\.bbappend \
               ${LAYERDIR}/common/recipes-core/initrdscripts/initramfs-live-install-efi.*\.bbappend \
               ${LAYERDIR}/common/recipes-bsp/gnu-efi/gnu-efi.*\.bbappend"

BBMASK += "${RMC_BBMASK}"

BBMASK_remove = "${@bb.utils.contains('DISTRO_FEATURES', 'rmc', '${RMC_BBMASK}', '', d)}"
```

## meta-intel/conf/machine/include/intel-corei7-64-common.inc
```bitbake
#
# Common configuration for all MACHINES of the intel-corei7-64 type
#

DEFAULTTUNE ?= "corei7-64"
require intel-common-pkgarch.inc
require conf/machine/include/tune-corei7.inc
require conf/machine/include/x86-base.inc
```

## meta-intel/conf/machine/include/intel-quark-common.inc
```bitbake
#
# Common configuration for all MACHINES of the intel-corei7-64 type
#

DEFAULTTUNE ?= "i586-nlp-32"
require conf/machine/include/tune-i586-nlp.inc
require conf/machine/include/x86-base.inc
```

## meta-intel/conf/machine/include/meta-intel-emgd.inc
```bitbake
INHERIT += "emgd-gl"
GLSUFFIX = "-emgd"
PACKAGE_EXTRA_ARCHS_append = " ${TUNE_PKGARCH}${GLSUFFIX}"

PREFERRED_PROVIDER_virtual/mesa ?= "mesa-gl"
PREFERRED_PROVIDER_virtual/libgl ?= "mesa-gl"
PREFERRED_PROVIDER_virtual/libgles1 ?= "emgd-driver-bin"
PREFERRED_PROVIDER_virtual/libgles2 ?= "emgd-driver-bin"
PREFERRED_PROVIDER_virtual/egl ?= "emgd-driver-bin"
```

## meta-intel/conf/machine/include/meta-intel.inc
```bitbake
#
# BSP variables and settings specific to the meta-intel layer.
# You must include the meta-intel layer in your bblayers.conf
# to use them.
#

#
# XSERVER subcomponents, used to build the XSERVER variable
#

# for Xserver older than 1.13.0
OLD_XSERVER_X86_EXT = "xserver-xorg-extension-dri \
           xserver-xorg-extension-dri2 \
           xserver-xorg-extension-extmod \
           xserver-xorg-extension-dbe \
           "

XSERVER_X86_EMGD = "emgd-driver-bin \
           ${OLD_XSERVER_X86_EXT} \
           "

XSERVER_X86_MATROX_MGA = "xf86-video-mga \
           "
```

## meta-intel/conf/machine/intel-core2-32.conf
```bitbake
#@TYPE: Machine
#@NAME: intel-core2-32

#@DESCRIPTION: Machine configuration for 32 bit Intel Core 2 CPU (and later) with MMX, SSE, SSE2, SSE3, and SSSE3 instruction set support. Supports a moderately wide range of drivers that should boot and be usable on "typical" hardware.

PREFERRED_PROVIDER_virtual/kernel = "linux-yocto-dev"

include conf/machine/include/intel-core2-32-common.inc
```

## meta-intel/conf/machine/intel-corei7-64.conf
```bitbake
#@TYPE: Machine
#@NAME: intel-corei7-64

#@DESCRIPTION: Machine configuration for 64 bit Intel Core i7 CPU (and later) with MMX, SSE, SSE2, SSE3, and SSSE3 instruction set support. Supports a moderately wide range of drivers that should boot and be usable on "typical" hardware.

PREFERRED_PROVIDER_virtual/kernel = "linux-yocto-dev"

require conf/machine/include/intel-corei7-64-common.inc
require conf/machine/include/intel-common-pkgarch.inc
```

## meta-intel/conf/machine/intel-quark.conf
```bitbake
#@TYPE: Machine
#@NAME: quark

#@DESCRIPTION: Machine configuration for Quark systems

require conf/machine/include/meta-intel.inc
require conf/machine/include/intel-quark-common.inc
require conf/machine/include/intel-common-pkgarch.inc

PREFERRED_PROVIDER_virtual/kernel ?= "linux-yocto"
PREFERRED_VERSION_linux-yocto ?= "4.1%"

#Avoid pulling in GRUB
MACHINE_ESSENTIAL_EXTRA_RDEPENDS = ""

MACHINE_FEATURES = "efi usb"
MACHINE_FEATURES += "intel-ucode"

MACHINE_EXTRA_RRECOMMENDS += "kernel-modules linux-firmware"

SERIAL_CONSOLE = "115200 ttyS1"
APPEND += "console=ttyS1,115200 console=tty0"

EFI_PROVIDER = "gummiboot"
```

## meta-intel/meta-cedartrail/conf/layer.conf
```bitbake
# We have a conf and classes directory, add to BBPATH
BBPATH .= ":${LAYERDIR}"

# We have a recipes directory, add to BBFILES
BBFILES += "${LAYERDIR}/recipes-*/*/*.bb \
	${LAYERDIR}/recipes-*/*/*.bbappend"

BBFILE_COLLECTIONS += "cedartrail"
BBFILE_PATTERN_cedartrail := "^${LAYERDIR}/"
BBFILE_PRIORITY_cedartrail = "6"

LAYERDEPENDS_cedartrail = "intel"
```

## meta-intel/meta-cedartrail/conf/machine/cedartrail-nopvr.conf
```bitbake
#@TYPE: Machine
#@NAME: cedartrail-nopvr

#@WEBTITLE: Intel Atom N2600/N2800/D2550 (Formerly Cedarview) Processor with NM10 Chipset (Cedar Trail Platform) with Open Source VESA Graphics

#@DESCRIPTION: Machine configuration for Cedar Trail systems
# i.e. N2600/N2800/D2550 + NM10

require conf/machine/include/tune-atom.inc
require conf/machine/include/ia32-base.inc

XSERVER ?= "${XSERVER_IA32_BASE} \
           ${XSERVER_IA32_EXT} \
           ${XSERVER_IA32_VESA} \
           "

SYSLINUX_OPTS = "serial 0 115200"
SERIAL_CONSOLE = "115200 ttyS0"
APPEND += "console=ttyS0,115200 console=tty0"
APPEND += "video=vesafb vga=0x318"
```

## meta-intel/meta-cedartrail/conf/machine/cedartrail.conf
```bitbake
#@TYPE: Machine
#@NAME: cedartrail

#@WEBTITLE: Intel Atom N2600/N2800/D2550 (Formerly Cedarview) Processor with NM10 Chipset (Cedar Trail Platform) and PVR Accelerated Graphics

#@DESCRIPTION: Machine configuration for Cedar Trail systems
# i.e. N2600/N2800/D2550 + NM10

require conf/machine/include/tune-atom.inc
require conf/machine/include/ia32-base.inc

MACHINE_FEATURES += "pcbios efi va-impl-intel"

XSERVER ?= "${XSERVER_IA32_BASE} \
           ${XSERVER_IA32_EXT} \
           cdv-pvr-driver \
           "
PREFERRED_VERSION_linux-yocto ?= "3.0%"
PREFERRED_VERSION_xserver-xorg ?= "1.9.3"
PREFERRED_VERSION_mesa-dri ?= "8.0.4"
PREFERRED_VERSION_xf86-input-evdev ?= "2.6.0"

SYSLINUX_OPTS = "serial 0 115200"
SERIAL_CONSOLE = "115200 ttyS0"
APPEND += "console=ttyS0,115200 console=tty0"

VA_FEATURES ?= "gst-va-intel va-intel"

MACHINE_EXTRA_RRECOMMENDS += "${VA_FEATURES}"
```

## meta-intel/meta-chiefriver/conf/layer.conf
```bitbake
# We have a conf and classes directory, add to BBPATH
BBPATH := "${BBPATH}:${LAYERDIR}"

# We have a recipes directory, add to BBFILES
BBFILES := "${BBFILES} ${LAYERDIR}/recipes-*/*/*.bb \
	${LAYERDIR}/recipes-*/*/*.bbappend"

BBFILE_COLLECTIONS += "chiefriver"
BBFILE_PATTERN_chiefriver := "^${LAYERDIR}/"
BBFILE_PRIORITY_chiefriver = "6"
```

## meta-intel/meta-chiefriver/conf/machine/chiefriver.conf
```bitbake
#@TYPE: Machine
#@NAME: chiefriver

#@WEBTITLE: Intel 3rd Generation Core Platforms: Core i3, i5, i7 (Ivy Bridge)

#@DESCRIPTION: Machine configuration for Chief River systems
# i.e. Ivy Bridge + Panther Point

PREFERRED_VERSION_linux-yocto ?= "3.10%"
MACHINE_FEATURES += "va-impl-intel"

require conf/machine/include/intel-corei7-64-common.inc

MACHINE_HWCODECS ?= "va-intel gst-va-intel"

XSERVER ?= "${XSERVER_X86_BASE} \
           ${XSERVER_X86_EXT} \
           ${XSERVER_X86_I965} \
           "

MACHINE_EXTRA_RRECOMMENDS += "lms7"
```

## meta-intel/meta-crownbay/conf/layer.conf
```bitbake
# We have a conf and classes directory, add to BBPATH
BBPATH := "${BBPATH}:${LAYERDIR}"

# We have a recipes directory, add to BBFILES
BBFILES := "${BBFILES} ${LAYERDIR}/recipes-*/*/*.bb \
	${LAYERDIR}/recipes-*/*/*.bbappend"

BBFILE_COLLECTIONS += "crownbay"
BBFILE_PATTERN_crownbay := "^${LAYERDIR}/"
BBFILE_PRIORITY_crownbay = "6"
```

## meta-intel/meta-crownbay/conf/machine/crownbay-noemgd.conf
```bitbake
#@TYPE: Machine
#@NAME: crownbay-noemgd

#@WEBTITLE: Intel Atom E6xx Processor With Intel EG20T Controller Hub Development Kit (Crown Bay) With Open Source VESA Graphics

#@DESCRIPTION: Machine configuration for Crown Bay systems, without Intel-proprietary graphics bits
# i.e. E660 + EG20T

PREFERRED_VERSION_linux-yocto ?= "3.14%"

require conf/machine/include/intel-core2-32-common.inc
require conf/machine/include/intel-common-pkgarch.inc

XSERVER ?= "${XSERVER_X86_BASE} \
           ${XSERVER_X86_EXT} \
           ${XSERVER_X86_VESA} \
           "

APPEND += "video=vesafb vga=0x318"
```

## meta-intel/meta-crownbay/conf/machine/crownbay.conf
```bitbake
#@TYPE: Machine
#@NAME: crownbay

#@WEBTITLE: Intel Atom E6xx Processor With Intel EG20T Controller Hub Development Kit (Crown Bay) With Proprietary IEMGD Accelerated Graphics

#@DESCRIPTION: Machine configuration for Crown Bay systems
# i.e. E660 + EG20T

PREFERRED_VERSION_linux-yocto ?= "3.10%"

require conf/machine/include/intel-core2-32-common.inc
require conf/machine/include/meta-intel.inc
require conf/machine/include/meta-intel-emgd.inc

MACHINE_FEATURES += "va-impl-mixvideo"

MACHINE_HWCODECS ?= "va-intel"
XSERVERCODECS ?= "emgd-driver-video emgd-gst-plugins-va \
                  emgd-gst-plugins-mixvideo gst-va-intel"

XSERVER ?= "${XSERVER_X86_BASE} \
           ${XSERVER_X86_EXT} \
           ${XSERVER_X86_EMGD} \
           "

PREFERRED_VERSION_xserver-xorg ?= "1.9.3"
PREFERRED_VERSION_xf86-input-synaptics ?= "1.6.3"
PREFERRED_VERSION_xf86-input-evdev ?= "2.6.0"
PREFERRED_VERSION_emgd-driver-bin ?= "1.18"
PREFERRED_VERSION_libva ?= "1.0.16"

APPEND += "video=vesafb vga=0x318 vmalloc=256MB"
```

## meta-intel/meta-crystalforest/conf/machine/crystalforest-gladden.conf
```bitbake
#@TYPE: Machine
#@NAME: crystalforest-gladden

#@WEBTITLE: Intel Xeon E3-1125C/E3-1105C (Formerly Sandy Bridge-Gladden)
#Processors with Intel Communication Chipset 89xx (Crystal Forest Gladden Platform)

#@DESCRIPTION: Machine configuration for Crystal Forest Gladden systems
#for Smaller Form Factor Communication Infrastructure
# i.e. Xeon E3-1125C/E3-1105C + Intel 89xx communication Chipset

PREFERRED_PROVIDER_virtual/kernel ?= "linux-yocto"
PREFERRED_VERSION_linux-yocto ?= "3.8%"

require conf/machine/include/tune-x86_64.inc
require conf/machine/include/ia32-base.inc
require conf/machine/include/meta-intel.inc

XSERVER ?= "${XSERVER_IA32_BASE} \
           ${XSERVER_IA32_EXT} \
	   ${XSERVER_IA32_MATROX_MGA} \
           "
MACHINE_EXTRA_RRECOMMENDS += "calgary-corpus \
			      canterbury-corpus \
			      zlib-qat-module \
			      openssl-qat-module \
			      "
#This Kernel Option is required for Intel Quick Assist Technology Software.
APPEND += "acpi_enforce_resources=lax"

#Uncomment the below Kernel Option if Virtualization is not needed.
#APPEND += "intel_iommu=off"

SYSLINUX_OPTS = "serial 0 115200"
SERIAL_CONSOLE = "115200 ttyS0"
APPEND += "console=ttyS0,115200 console=tty0"
```

## meta-intel/meta-crystalforest/conf/machine/crystalforest-server.conf
```bitbake
#@TYPE: Machine
#@NAME: crystalforest-server

#@WEBTITLE: Intel Xeon E5-2600 and E5-2400 (Formerly Sandy Bridge-EP/EN)
#Processors with Intel Communication Chipset 89xx (Crystal Forest Server Platform)

#@DESCRIPTION: Machine configuration for Crystal Forest Server systems
#for Large-Scale Communications Infrastructure
# i.e. Xeon E5-2600 and E5-2400 + Intel 89xx Communication Chipsets

PREFERRED_PROVIDER_virtual/kernel ?= "linux-yocto"
PREFERRED_VERSION_linux-yocto ?= "3.10%"

require conf/machine/include/intel-corei7-64-common.inc
require conf/machine/include/intel-common-pkgarch.inc
require conf/machine/include/meta-intel.inc

XSERVER ?= "${XSERVER_X86_BASE} \
           ${XSERVER_X86_EXT} \
	   ${XSERVER_X86_MATROX_MGA} \
           "
MACHINE_EXTRA_RRECOMMENDS += "calgary-corpus \
                              canterbury-corpus \
                              "
#This Kernel Option is required for Intel Quick Assist Technology Software.
APPEND += "acpi_enforce_resources=lax"

#Uncomment the below Kernel Option if Virtualization is not needed.
#APPEND += "intel_iommu=off"

SYSLINUX_OPTS = "serial 0 115200"
SERIAL_CONSOLE = "115200 ttyS0"
APPEND += "console=ttyS0,115200 console=tty0"
```

## meta-intel/meta-crystalforest/conf/machine/crystalforest-shumway.conf
```bitbake
#@TYPE: Machine
#@NAME: crystalforest-shumway 

#@DESCRIPTION: Machine configuration for Crystal Forest  Server (SHUMWAY) systems
# i.e. Two Sandy Bridge Jaketown processors (SNB-EP ES2 Grade and SNB-EN ES2 Grade) + Two Cave Creek Chipsets.

PREFERRED_PROVIDER_virtual/kernel ?= "linux-yocto"
PREFERRED_VERSION_linux-yocto ?= "3.4%"

require conf/machine/include/tune-x86_64.inc
require conf/machine/include/ia32-base.inc
require conf/machine/include/meta-intel.inc

XSERVER ?= "${XSERVER_IA32_BASE} \
           ${XSERVER_IA32_EXT} \
	   ${XSERVER_IA32_MATROX_MGA} \
           "
#This Kernel Option is required for Intel Quick Assist Technology Software.
APPEND += "acpi_enforce_resources=lax"

#Uncomment the below Kernel Option if Virtualization is not needed.
#APPEND += "intel_iommu=off"

SYSLINUX_OPTS = "serial 0 115200"
SERIAL_CONSOLE = "115200 ttyS0"
APPEND += "console=ttyS0,115200 console=tty0"
```
