## meta-ostro-fixes/conf/layer.conf
```bitbake
BBPATH .= ":${LAYERDIR}"

BBFILES += "${LAYERDIR}/*-fixes/recipes-*/*/*.bb \
            ${LAYERDIR}/*-fixes/recipes-*/*/*.bbappend \
            ${LAYERDIR}/*-fixes/recipes-*/*/*/*.bb \
            ${LAYERDIR}/*-fixes/recipes-*/*/*/*.bbappend"

BBFILE_COLLECTIONS += "ostro-fixes"
BBFILE_PATTERN_ostro-fixes = "^${LAYERDIR}/"

# Set very high priority. Needs to be higher than the priority
# of any layer that we are fixing.
BBFILE_PRIORITY_ostro-fixes = "9"

# Layer may be empty occassionally. Do not warn about that.
BBFILE_PATTERN_IGNORE_EMPTY_ostro-fixes = "1"
```

## meta-ostro-fixes/meta-intel-iot-middleware-fixes/conf/layer.conf
```bitbake
BBPATH .= ":${LAYERDIR}"

BBFILES += "${LAYERDIR}/recipes-*/*/*.bb \
            ${LAYERDIR}/recipes-*/*/*.bbappend"

BBFILE_COLLECTIONS += "intel-iot-mw-fixes"
BBFILE_PATTERN_intel-iot-mw-fixes = "^${LAYERDIR}/"

# set priority to intel-iot-mw +1
BBFILE_PRIORITY_intel-iot-mw-fixes = "9"
```

## meta-ostro-fixes/meta-oic-fixes/conf/layer.conf
```bitbake
BBPATH .= ":${LAYERDIR}"

BBFILES += "${LAYERDIR}/recipes-*/*/*.bb \
            ${LAYERDIR}/recipes-*/*/*.bbappend"

BBFILE_COLLECTIONS += "oic-fixes"
BBFILE_PATTERN_oic-fixes = "^${LAYERDIR}/"

# set priority to meta-oic-fixes +1
BBFILE_PRIORITY_oic-fixes = "7"
```

## meta-ostro/conf/bblayers.conf.sample
```bitbake
# LAYER_CONF_VERSION is increased each time build/conf/bblayers.conf
# changes incompatibly
LCONF_VERSION = "5"

BBPATH = "${TOPDIR}"
BBFILES ?= ""

BBLAYERS ?= " \
  ##OEROOT##/meta \
  ##OEROOT##/meta-intel \
  ##OEROOT##/meta-ostro \
  ##OEROOT##/meta-oic \
  ##OEROOT##/meta-security-smack \
  ##OEROOT##/meta-security-framework \
  ##OEROOT##/meta-integrity \
  ##OEROOT##/meta-intel-iot-middleware \
  ##OEROOT##/meta-ostro-fixes \
  ##OEROOT##/meta-ostro-bsp \
  ##OEROOT##/meta-ostro-bsp/meta-edison-bsp \
  ##OEROOT##/meta-iot-web \
  ##OEROOT##/meta-yocto-bsp \
  ##OEROOT##/meta-iotqa \
  ##OEROOT##/meta-user-management \
  ##OEROOT##/meta-appfw \
  ##OEROOT##/meta-sensor-framework \
  "

# toaster uses this hint to decide whether it let's the user
# remove a layer from BBLAYERS. All layers which provide something
# that is required to build ostro-image should be listed here.
# We do not really track that, so add all layers also here.
BBLAYERS_NON_REMOVABLE ?= " \
  ##OEROOT##/meta \
  ##OEROOT##/meta-intel \
  ##OEROOT##/meta-ostro \
  ##OEROOT##/meta-oic \
  ##OEROOT##/meta-security-smack \
  ##OEROOT##/meta-security-framework \
  ##OEROOT##/meta-integrity \
  ##OEROOT##/meta-intel-iot-middleware \
  ##OEROOT##/meta-ostro-fixes \
  ##OEROOT##/meta-ostro-bsp \
  ##OEROOT##/meta-iot-web \
  ##OEROOT##/meta-yocto-bsp \
  ##OEROOT##/meta-iotqa \
  ##OEROOT##/meta-user-management \
  ##OEROOT##/meta-appfw \
  ##OEROOT##/meta-sensor-framework \
  "
```

## meta-ostro/conf/distro/include/ostro-os-core-x11.inc
```bitbake
DISTRO_FEATURES_append = " x11"
DISTRO_FEATURES_append = " opengl"
OSTRO_IMAGE_EXTRA_INSTALL_append = " packagegroup-core-x11 xterm twm"
```

## meta-ostro/conf/distro/include/ostro-os-development.inc
```bitbake
# Use the pre-generated keys for IMA signing.
IMA_EVM_KEY_DIR = "${IMA_EVM_BASE}/data/debug-keys"

# Enable local root access.
OSTRO_EXTRA_IMAGE_FEATURES += "autologin"

# Mark images as "development" by extending /etc/motd.
OSTRO_EXTRA_MOTD () {
************************************
*** This is a development image! ***
*** Do not use in production.    ***
************************************
}

# Everything ready, avoid initial sanity check.
OSTRO_IMAGE_BUILD_MODE_SELECTED = "1"
```

## meta-ostro/conf/distro/include/ostro-os-production.inc
```bitbake
# If IMA is used, then the signing key must be configured explicitly
# in local.conf. In contrast to ostro-os-development.inc, no fallback
# is provided.

# Disable consoles and make journald quiet (=disable system logging).
OSTRO_IMAGE_EXTRA_FEATURES_append = " muted"

# Everything is (hopefully) ready, avoid initial sanity check.
OSTRO_IMAGE_BUILD_MODE_SELECTED = "1"
```

## meta-ostro/conf/distro/include/ostro-x11.inc
```bitbake
# Remove x11 from REQUIRED_DISTRO_FEATURES from certain x11 libraries
# Allows building certain recipes (like openjdk) that depend on x11
# without including x11 in the image 
REQUIRED_DISTRO_FEATURES_remove_pn-libxt = "x11"
REQUIRED_DISTRO_FEATURES_remove_pn-libxt-native = "x11"
REQUIRED_DISTRO_FEATURES_remove_pn-libxinerama = "x11"
REQUIRED_DISTRO_FEATURES_remove_pn-libxrender = "x11"
REQUIRED_DISTRO_FEATURES_remove_pn-libxrender-native = "x11"
REQUIRED_DISTRO_FEATURES_remove_pn-libxtst = "x11"
REQUIRED_DISTRO_FEATURES_remove_pn-libxi = "x11"
REQUIRED_DISTRO_FEATURES_remove_pn-libx11 = "x11"
REQUIRED_DISTRO_FEATURES_remove_pn-libx11-native = "x11"
REQUIRED_DISTRO_FEATURES_remove_pn-libxext = "x11"
REQUIRED_DISTRO_FEATURES_remove_pn-libxext-native = "x11"
REQUIRED_DISTRO_FEATURES_remove_pn-libxcursor = "x11"
REQUIRED_DISTRO_FEATURES_remove_pn-libxrandr = "x11"
REQUIRED_DISTRO_FEATURES_remove_pn-libxdamage = "x11"
REQUIRED_DISTRO_FEATURES_remove_pn-libxcomposite = "x11"
REQUIRED_DISTRO_FEATURES_remove_pn-libxcb = "x11"
REQUIRED_DISTRO_FEATURES_remove_pn-libxcb-native = "x11"
REQUIRED_DISTRO_FEATURES_remove_pn-libsm = "x11"
REQUIRED_DISTRO_FEATURES_remove_pn-libsm-native = "x11"
REQUIRED_DISTRO_FEATURES_remove_pn-libxdmcp = "x11"
REQUIRED_DISTRO_FEATURES_remove_pn-libxdmcp-native = "x11"
REQUIRED_DISTRO_FEATURES_remove_pn-libxfixes = "x11"
REQUIRED_DISTRO_FEATURES_remove_pn-xtrans = "x11"
REQUIRED_DISTRO_FEATURES_remove_pn-xtrans-native = "x11"
REQUIRED_DISTRO_FEATURES_remove_pn-libxau = "x11"
REQUIRED_DISTRO_FEATURES_remove_pn-libxau-native = "x11"
REQUIRED_DISTRO_FEATURES_remove_pn-libice = "x11"
REQUIRED_DISTRO_FEATURES_remove_pn-libice-native = "x11"
```

## meta-ostro/conf/distro/include/ostro_security_flags.inc
```bitbake
# Include security flags pulled in via openembedded-core.
require conf/distro/include/security_flags.inc

SECURITY_PIC_CFLAGS ?= "-fpic"

# Add Ostro OS specific flags to fix build issues with
# recipes that are being used in Ostro OS.
SECURITY_CFLAGS_pn-zeromq = "${SECURITY_NO_PIE_CFLAGS} ${SECURITY_PIC_CFLAGS}"
SECURITY_CFLAGS_pn-mraa = "${SECURITY_NO_PIE_CFLAGS} ${SECURITY_PIC_CFLAGS}"
SECURITY_CFLAGS_pn-upm = "${SECURITY_NO_PIE_CFLAGS} ${SECURITY_PIC_CFLAGS}"
SECURITY_CFLAGS_pn-iot-app-fw = "${SECURITY_NO_PIE_CFLAGS} ${SECURITY_PIC_CFLAGS}"
SECURITY_CFLAGS_pn-iotivity = "${SECURITY_NO_PIE_CFLAGS} ${SECURITY_PIC_CFLAGS}"
SECURITY_CFLAGS_pn-krb5 = "${SECURITY_NO_PIE_CFLAGS} ${SECURITY_PIC_CFLAGS}"

# Additional exceptions for packages in Ostro OS which do not
# compile with -Wformat-security as error (sorted alphabetically).
SECURITY_STRINGFORMAT_pn-dash = ""
SECURITY_STRINGFORMAT_pn-giflib = ""
SECURITY_STRINGFORMAT_pn-gsignond = ""
SECURITY_STRINGFORMAT_pn-openjdk-8 = ""
SECURITY_STRINGFORMAT_pn-openjre-8 = ""
```

## meta-ostro/conf/distro/include/ostroproject-ci.inc
```bitbake
#
# https://ostroproject.org/jenkins CI configuration:
# This file applied via conf/auto.conf for every build
# happening in Ostro Project CI
#

#
# Static section
# Items that are always present in any CI build:
#

# Generate summary statistics
INHERIT += "buildstats-summary"

# Enable CVE and other secutiry checks
INHERIT += "isafw"

# Enable extended buildhistory:
INHERIT += "buildhistory"
BUILDHISTORY_COMMIT = "1"
INHERIT += "buildhistory-extra"

# Test data generation:
INHERIT += "test-iot"
TEST_EXPORT_DIR = "iottest"
TEST_TARGET = "simpleremote"

# SDK defaults:
SDKMACHINE ?= "x86_64"

# Generate source mirror tarballs:
BB_GENERATE_MIRROR_TARBALLS = "1"

# Include the devel settings
require conf/distro/include/ostro-os-development.inc

# XXX Drop the VM hack after taking care also of the non UEFI devices
# (those using U-Boot: edison and beaglebone)
OSTRO_VM_IMAGE_TYPES = "dsk.xz dsk.zip dsk.vdi.zip"

#
# Automated build targets
# Those targets should be space separated list of items,
# which must contain only alphanumeric symbols,'-' and '_'.
# Any other symbols would be skipped in parser.
#
# Following targets would be used to perform default build task:
OSTROPROJECT_CI_BUILD_TARGETS="${DISTRO}-image ${DISTRO}-image-dev"
# Following targets would be executed with do_populate_sdk task
OSTROPROJECT_CI_SDK_TARGETS=""
# Following targets would be executed with do_populate_sdk_ext task
OSTROPROJECT_CI_ESDK_TARGETS="${DISTRO}-image"
# Following targets would be executed with do_test_iot_export task
OSTROPROJECT_CI_TEST_EXPORT_TARGETS="${DISTRO}-image"
# Execute automatic tests for following images with corresponding
# test suite and test files.
# Space separated list of tuples, each should in format:
# <image_name>,<testsuite_name>,<testfiles_name>,$MACHINE
OSTROPROJECT_CI_TEST_RUNS="${DISTRO}-image,iot-testsuite.tar.gz,iot-testfiles.${MACHINE}.tar.gz,${MACHINE}"

#
# Dymamic section.
# Values are applied dynamically based on runtime config or builder host
# parameters.
# Present here as reference only.
#

# Explicit machine declaration by build job:
# MACHINE = "$TARGET_MACHINE"

# Shared download directory between builders:
# DL_DIR = "/srv/bb-cache/ostro-os/sources"

# Limit CPU utilization, based on amount of slots/CPU cores
# on builder hosts:
# BB_NUMBER_PARSE_THREADS = "X"
# BB_NUMBER_THREADS = "X"
# PARALLEL_MAKE = "-j X"

# Local optimizations on SSTATE directories, shared between builder hosts:
# SSTATE_MIRRORS ?= "file://.* http://$IP/bb-cache/ostro-os/sstate/PATH"
# SSTATE_DIR ?= "/var/tmp/sstate-$slot"

# Local directory, where builder puts local copy of buildhistory
# BUILDHISTORY_DIR ?="$WORKSPACE/buildhistory"

# PRserv host dynamically allocated by master:
# PRSERV_HOST = "$IP:$PORT"

# Enabled for master release builds:
# INHERIT += "archiver"
# ARCHIVER_MODE[src] = "original"
# ARCHIVER_MODE[diff] = "1"
# ARCHIVER_MODE[recipe] = "1"
```

## meta-ostro/conf/distro/ostro.conf
```bitbake
DISTRO = "ostro"
DISTRO_NAME = "Ostro OS"
DISTRO_VERSION = "1.0~M2~snapshot-${DATE}"
SDK_VENDOR = "-ostrosdk"
SDK_VERSION := "${@'${DISTRO_VERSION}'.replace('snapshot-${DATE}','snapshot')}"
SDK_NAME_PREFIX = "ostro"

MAINTAINER = "Ostro Dev <ostro-dev@lists.ostroproject.org>"

TARGET_VENDOR = "-ostro"

OSTRO_DEFAULT_DISTRO_FEATURES = "systemd bluez5 pam"
OSTRO_DEFAULT_EXTRA_RDEPENDS ??= ""
OSTRO_DEFAULT_EXTRA_RRECOMMENDS ??= ""

# Smack security is a distribution feature which can be enabled or
# disabled as needed. To simplify recipes, there is also a smack
# override.
#
# If we have Smack, we can use Cynara. The "dbus-cynara" distro
# feature ensures that we build D-Bus with Cynara support. This locks
# down the D-Bus system and session busses such that apps do not get
# access to D-Bus services unless the service explicitly declares that
# it is ready to deal with talking to less privileged apps.
#
# At the moment, these settings must be kept in sync manually:
# * The "smack" override must be set if and only if the "smack"
#   distro feature is set.
# * The "dbus-cynara" distro feature depends on the "smack",
#   but "smack" can also be used without it.
#
# In other words, to disable the default in a local.conf, change two variables
# like this:
#  OSTRO_SMACK_OVERRIDE = ""
#  OSTRO_DEFAULT_DISTRO_FEATURES_remove = "smack dbus-cynara"
#
# To disable just dbus-cynara, use:
#  OSTRO_DEFAULT_DISTRO_FEATURES_remove = "dbus-cynara"
OSTRO_DEFAULT_DISTRO_FEATURES += "smack dbus-cynara"
OSTRO_SMACK_OVERRIDE ?= ":smack"
DISTROOVERRIDES .= "${OSTRO_SMACK_OVERRIDE}"

# IMA/EVM depend on compiling some components (currently the kernel)
# differently. This distro feature enables that.
OSTRO_DEFAULT_DISTRO_FEATURES += "ima"

# Remove currently unsupported distro features from global defaults
DISTRO_FEATURES_DEFAULT_remove = "x11 3g"

DISTRO_FEATURES ?= "${DISTRO_FEATURES_DEFAULT} ${DISTRO_FEATURES_LIBC} ${OSTRO_DEFAULT_DISTRO_FEATURES}"

# Use 4.1 kernel for core2 and corei7.
# BeagleBone (and others) remain unchanged on default kernel version.
PREFERRED_VERSION_linux-yocto_intel-core2-32 ?= "4.1%"
PREFERRED_VERSION_linux-yocto_intel-corei7-64 ?= "4.1%"

DISTRO_EXTRA_RDEPENDS += " ${OSTRO_DEFAULT_EXTRA_RDEPENDS}"
DISTRO_EXTRA_RRECOMMENDS += " ${OSTRO_DEFAULT_EXTRA_RRECOMMENDS}"

QEMU_TARGETS ?= "arm i386 x86_64"

VIRTUAL-RUNTIME_init_manager = "systemd"
VIRTUAL-RUNTIME_initscripts = ""
DISTRO_FEATURES_BACKFILL_CONSIDERED = "sysvinit"

require conf/distro/include/ostro_security_flags.inc

OS_RELEASE_FIELDS_append = " BUILD_ID"

# QA check settings - a little stricter than the OE-Core defaults
WARN_TO_ERROR_QA = "already-stripped compile-host-path install-host-path \
                    installed-vs-shipped ldflags pn-overrides rpaths staticdev \
                    useless-rpaths build-deps"
WARN_QA_remove = "${WARN_TO_ERROR_QA}"
ERROR_QA_append = " ${WARN_TO_ERROR_QA}"

# Only specific recipes from the layers in meta-openembedded are
# supported in combination with Ostro OS, even though all of
# meta-openembedded gets imported into the combined repository.
#
# To use recipes from meta-openembedded, they must be added to the
# respective PNWHITELIST variables, here for officially supported ones
# or in a local.conf for inofficial ones in a personal build (_append,
# += and = all work in a local.conf).
#
# To remove white-listing of a layer (i.e. enable all of its recipes),
# remove the layer from PNWHITELIST_LAYERS.
#
# Note that bblayer.conf.sample only adds layers which have enabled
# recipes. Add or remove layers there as needed when changing the white
# lists below.
INHERIT += "whitelist"
PNWHITELIST_REASON = "not supported by ${DISTRO}"

PNWHITELIST_LAYERS = " \
    efl-layer \
    filesystems-layer \
    gnome-layer \
    gpe-layer \
    meta-initramfs \
    meta-python \
    multimedia-layer \
    networking-layer \
    openembedded-layer \
    perl-layer \
    ruby-layer \
    systemd-layer \
    toolchain-layer \
    webserver \
    xfce-layer \
"

# Using += here so that we extend an earlier value from local.conf
# instead of overwriting it.
PNWHITELIST_efl-layer += ""
PNWHITELIST_filesystems-layer += ""
PNWHITELIST_gnome-layer += ""
PNWHITELIST_gpe-layer += ""
PNWHITELIST_meta-initramfs += ""
PNWHITELIST_meta-python += " \
    python-m2crypto-native \
"
PNWHITELIST_multimedia-layer += ""
PNWHITELIST_networking-layer += " \
    lowpan-tools \
"
PNWHITELIST_openembedded-layer += " \
    gmock \
    gtest \
    libsocketcan \
    can-utils \
"
PNWHITELIST_perl-layer += ""
PNWHITELIST_ruby-layer += ""
PNWHITELIST_systemd-layer += ""
PNWHITELIST_toolchain-layer += ""
PNWHITELIST_webserver += ""
PNWHITELIST_xfce-layer += ""
```
