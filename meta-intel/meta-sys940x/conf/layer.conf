## meta-intel/meta-sys940x/conf/layer.conf
```bitbake
# We have a conf and classes directory, add to BBPATH
BBPATH .= ":${LAYERDIR}"

# We have a recipes directory, add to BBFILES
BBFILES += "${LAYERDIR}/recipes-*/*/*.bb \
	${LAYERDIR}/recipes-*/*/*.bbappend"

BBFILE_COLLECTIONS += "sys940x"
BBFILE_PATTERN_sys940x := "^${LAYERDIR}/"
BBFILE_PRIORITY_sys940x = "6"

LAYERDEPENDS_sys940x = "intel"
```

## meta-intel/meta-sys940x/conf/machine/sys940x-noemgd.conf
```bitbake
#@TYPE: Machine
#@NAME: sys940x-noemgd

#@WEBTITLE: Intel Atom E6xx Processor with Intel EG20T Controller Hub Development Kit (Queens Bay) with Open Source VESA Graphics for Inforce SYS940X systems.

#@DESCRIPTION: Machine configuration for Inforce SYS940X systems, without Intel-proprietary graphics bits

require conf/machine/include/intel-core2-32-common.inc

# Add "pcbios" if you have a non-efi version of the firmware
MACHINE_FEATURES += "efi pcbios"

PREFERRED_VERSION_linux-yocto ?= "3.10%"

XSERVER ?= "${XSERVER_X86_BASE} \
           ${XSERVER_X86_EXT} \
           ${XSERVER_X86_VESA} \
           "

SERIAL_CONSOLE = "115200 ttyS0"
APPEND += "console=ttyS0,115200 console=tty0"
```

## meta-intel/meta-sys940x/conf/machine/sys940x.conf
```bitbake
#@TYPE: Machine
#@NAME: sys940x

#@WEBTITLE: Intel Atom E6xx Processor with Intel EG20T Controller Hub Development Kit (Queens Bay) with Proprietary IEMGD Accelerated Graphics

#@DESCRIPTION: Machine configuration for Inforce SYS940x systems

require conf/machine/include/tune-atom.inc
require conf/machine/include/ia32-base.inc
require conf/machine/include/meta-intel.inc

# Add "pcbios" if you have a non-efi version of the firmware
MACHINE_FEATURES += "efi pcbios gst-va-mixvideo"

PREFERRED_VERSION_linux-yocto ?= "3.8%"

MACHINE_HWCODECS ?= "va-intel"
XSERVERCODECS ?= "emgd-driver-video emgd-gst-plugins-va \
                  emgd-gst-plugins-mixvideo gst-va-intel"

XSERVER ?= "${XSERVER_IA32_BASE} \
           ${XSERVER_IA32_EXT} \
           ${XSERVER_IA32_EMGD} \
           "

PREFERRED_VERSION_xserver-xorg ?= "1.9.3"
PREFERRED_VERSION_mesa ?= "9.1.3"
PREFERRED_VERSION_xf86-input-synaptics ?= "1.6.3"
PREFERRED_VERSION_xf86-input-evdev ?= "2.6.0"
PREFERRED_VERSION_emgd-driver-bin ?= "1.16"
PREFERRED_VERSION_libva ?= "1.0.16"

SERIAL_CONSOLE = "115200 ttyS0"
APPEND += "console=ttyS0,115200 console=tty0"
```

## meta-intel/meta-tlk/conf/layer.conf
```bitbake
# We have a conf and classes directory, add to BBPATH
BBPATH .= ":${LAYERDIR}"

# We have recipes-* directories, add to BBFILES
BBFILES += "${LAYERDIR}/recipes-*/*/*.bb \
	${LAYERDIR}/recipes-*/*/*.bbappend"

BBFILE_COLLECTIONS += "tlk"
BBFILE_PATTERN_tlk := "^${LAYERDIR}/"
BBFILE_PRIORITY_tlk = "5"
```

## meta-iot-web/conf/layer.conf
```bitbake
BBPATH .= ":${LAYERDIR}"

BBFILES += "${LAYERDIR}/recipes-*/*/*.bb ${LAYERDIR}/recipes-*/*/*.bbappend"

BBFILE_COLLECTIONS += "iotweb"
BBFILE_PATTERN_iotweb := "^${LAYERDIR}/"
BBFILE_PRIORITY_iotweb = "9"
```

## meta-iotqa/meta-iotqa/conf/layer.conf
```bitbake
# We have a conf and classes directory, add to BBPATH
BBPATH .= ":${LAYERDIR}"

# We have recipes-* directories, add to BBFILES
BBFILES += "${LAYERDIR}/recipes-*/*/*.bb \
	${LAYERDIR}/recipes-*/*/*.bbappend"

BBFILE_COLLECTIONS += "iotqa"
BBFILE_PATTERN_iotqa = "^${LAYERDIR}/"
BBFILE_PRIORITY_iotqa = "5"
```

## meta-ostro-bsp/conf/layer.conf
```bitbake
# We have a conf and classes directory, add to BBPATH
BBPATH := "${BBPATH}:${LAYERDIR}"

# We have a recipes directory, add to BBFILES
BBFILES := "${BBFILES} ${LAYERDIR}/recipes-*/*/*.bb \
	${LAYERDIR}/recipes-*/*/*.bbappend"

BBFILE_COLLECTIONS += "quark-bsp"
BBFILE_PATTERN_quark-bsp := "^${LAYERDIR}/"
BBFILE_PRIORITY_quark-bsp = "6"

# Normally one would use MACHINE_ESSENTIAL_EXTRA_RDEPENDS in a machine
# config, but we use existing machine configurations and thus cannot
# do that. Extending via layer config with machine override is close
# enough.

MACHINE_ESSENTIAL_EXTRA_RDEPENDS_append_intel-corei7-64 = " \
    spi-minnowmax-board \
    i2c-minnowmax-board \
"

MACHINE_ESSENTIAL_EXTRA_RDEPENDS_append_intel-quark = " \
    spi-quark-board \
    i2c-quark-board \
"

MACHINE_ESSENTIAL_EXTRA_RDEPENDS_append_edison = " \
    i2c-edison-board \
"

# Could be also in edison.conf, kept here for sake of consistency.
MACHINE_ESSENTIAL_EXTRA_RDEPENDS_append_edison = " systemd-watchdog"
MACHINE_ESSENTIAL_EXTRA_RDEPENDS_append_beaglebone = " systemd-watchdog"
# Actually only relevant on MinnowMax, but causes little harm
# elsewhere (unnecessary sleep wakeup every 45 seconds).
MACHINE_ESSENTIAL_EXTRA_RDEPENDS_append_intel-corei7-64 = " systemd-watchdog"
```

## meta-ostro-bsp/conf/machine/atom.conf
```bitbake
#@TYPE: Machine
#@NAME: atom

#@DESCRIPTION: Machine configuration for Atom systems

PREFERRED_PROVIDER_virtual/kernel ?= "linux-ostro"
PREFERRED_VERSION_linux-yocto ?= "4.1%"

#DEFAULTTUNE = "core2-32"

require conf/machine/include/x86-base.inc
include conf/machine/include/tune-atom.inc

MACHINE_FEATURES += "usb pci"
#MACHINE_FEATURES += "efi"
#EFI_PROVIDER = "gummiboot"

#APPEND += "console=ttyS0,115200n8 rw"

SYSLINUX_OPTS = "serial 0 115200"
SERIAL_CONSOLE = "115200 ttyS0"
#SERIAL_CONSOLES = "115200;ttyS0 115200;ttyS1"
```

## meta-ostro-bsp/conf/machine/quark.conf
```bitbake
#@TYPE: Machine
#@NAME: quark

#@DESCRIPTION: Machine configuration for Quark systems

PREFERRED_PROVIDER_virtual/kernel ?= "linux-ostro"
PREFERRED_VERSION_linux-yocto ?= "4.1%"

require conf/machine/include/x86-base.inc
include conf/machine/include/tune-i586.inc

MACHINE_FEATURES += "efi usb pci"
#EFI_PROVIDER = "gummiboot"

APPEND += "console=ttyS1,115200n8 earlycon=uart8250,mmio32,0x8010f000,115200n8 reboot=efi,warm apic=debug rw"

SERIAL_CONSOLE = "115200 ttyS1"
#SERIAL_CONSOLES = "115200;ttyS0 115200;ttyS1"
```

## meta-ostro-bsp/meta-edison-bsp/conf/layer.conf
```bitbake
# We have a conf and classes directory, add to BBPATH
BBPATH := "${BBPATH}:${LAYERDIR}"

# We have a recipes-* directories, add to BBFILES
BBFILES := "${BBFILES} ${LAYERDIR}/recipes-*/*/*.bb \
	${LAYERDIR}/recipes-*/*/*.bbappend"

BBFILE_COLLECTIONS += "edison"
BBFILE_PATTERN_edison = "^${LAYERDIR}/"
BBFILE_PRIORITY_edison = "6"
```

## meta-ostro-bsp/meta-edison-bsp/conf/machine/edison.conf
```bitbake
#@TYPE: Machine
#@NAME: edison
#@DESCRIPTION: Machine configuration for edison systems

DEFAULTTUNE ?= "edison"
X86ARCH32 ?= "i686"

require conf/machine/include/x86/arch-x86.inc

TUNEVALID[edison] = "Enable Edison specific processor optimizations"
TUNE_CCARGS .= "${@bb.utils.contains('TUNE_FEATURES', 'edison', ' -march=atom -msse3 -mfpmath=sse', '', d)}"

AVAILTUNES += "edison"
TUNE_FEATURES_tune-edison = "${TUNE_FEATURES_tune-x86} edison"
BASE_LIB_tune-edison = "lib"
TUNE_PKGARCH_tune-edison = "edison"
# Edison is already in package archs
#PACKAGE_EXTRA_ARCHS_tune-edison = "${PACKAGE_EXTRA_ARCHS_tune-x86} edison"


MACHINE_FEATURES = "bluetooth alsa pci serial usbgadget usbhost wifi x86 ext3"

IMAGE_CLASSES += "image_types_edison"
IMAGE_FSTYPES = "tar.bz2 ext4 toflash"

# we want rootfs size of 1572864
# rootfs_rpm.bbclass adds 51200
# so adjust to 1572864 - 51200
IMAGE_ROOTFS_SIZE = "1521664"
# Also, Ostro OS is not allowed to ask for additional space either.
# TODO: this should be a variable from OE-core which gets
# added by rootfs_rpm.bbclass, instead of doing the increase twice
# and having to substract the 51200 value above.
OSTRO_IMAGE_ROOTFS_EXTRA_SPACE = ""

# Bootloader config

PREFERRED_PROVIDER_virtual/bootloader ?=  "u-boot-edison"
PREFERRED_VERSION_u-boot-edison ?= "2014.04-1"
PREFERRED_VERSION_u-boot-fw-utils-edison ?= "2014.04-1"
UBOOT_MACHINE = "edison_config"

MACHINE_ESSENTIAL_EXTRA_RRECOMMENDS += "u-boot-edison u-boot-fw-utils-edison kernel-modules sst-fw mcu-fw-bin mcu-fw-load"
MACHINE_ESSENTIAL_EXTRA_RDEPENDS += "bluetooth-rfkill-event"

# Kernel config

PREFERRED_PROVIDER_virtual/kernel ?= "linux-yocto-edison"
PREFERRED_VERSION_linux-yocto-edison = "3.10%"
KERNEL_IMAGETYPE = "bzImage"
SERIAL_CONSOLES ?= "115200;ttyMFD2 115200;ttyGS0"

MACHINE_ESSENTIAL_EXTRA_RRECOMMENDS += "kernel-module-bcm-bt-lpm bcm43340-bt"
KERNEL_MODULE_AUTOLOAD += "bcm_bt_lpm"

MACHINE_ESSENTIAL_EXTRA_RRECOMMENDS += "bcm43340-mod bcm43340-fw"
KERNEL_MODULE_AUTOLOAD  += "bcm4334x"
KERNEL_MODULE_PROBECONF += "bcm4334x"
module_conf_bcm4334x = "options bcm4334x firmware_path=/etc/firmware/fw_bcmdhd.bin nvram_path=/etc/firmware/bcmdhd.cal"

MACHINE_ESSENTIAL_EXTRA_RRECOMMENDS += "kernel-module-g-multi"
KERNEL_MODULE_AUTOLOAD  += "g_multi"
KERNEL_MODULE_PROBECONF += "g_multi"
# FIXME: file parameter should be based on partition UUID (from U-Boot) or fixed
# with label (label seems to work, but driver is probed too early)
module_conf_g_multi = "options g_multi file=/dev/mmcblk0p9 stall=0 idVendor=0x8087 idProduct=0x0A9E iProduct=Edison iManufacturer=Intel"

XSERVER = "xserver-xorg \
           xf86-input-keyboard \
           xf86-input-evdev \
           xf86-video-dummy"

#INITRAMFS_IMAGE ?= "core-image-initramfs-edison"
#INITRAMFS_IMAGE_BUNDLE ?= "1"
```

## meta-ostro-bsp/meta-edison-bsp/conf/machine/include/edison-image-config.inc
```bitbake
# include this file to customize standard Yocto images for edison

IMAGE_FEATURES += "debug-tweaks package-management ssh-server-openssh"

ROOTFS_POSTPROCESS_COMMAND += " edison_image_fixup ; "

edison_image_fixup() {

	cd ${IMAGE_ROOTFS}

	# add wpa_supplicant config for wlan0
	if [ -e etc/wpa_supplicant.conf ] ; then
		mkdir etc/wpa_supplicant
		cp etc/wpa_supplicant.conf etc/wpa_supplicant/wpa_supplicant-wlan0.conf
		ln -s /lib/systemd/system/wpa_supplicant@.service etc/systemd/system/multi-user.target.wants/wpa_supplicant@wlan0.service
		echo "[Match]"    >  etc/systemd/network/wlan0.network
		echo "Name=wlan0" >> etc/systemd/network/wlan0.network
		echo "[Network]"  >> etc/systemd/network/wlan0.network
		echo "DHCP=yes"   >> etc/systemd/network/wlan0.network
	fi
}

ROOTFS_POSTPROCESS_COMMAND =+ " add_custom_smart_config ; "

add_custom_smart_config() {

	if [ -d ${IMAGE_ROOTFS}/var/lib/smart ] ; then
		smart	--data-dir=${IMAGE_ROOTFS}/var/lib/smart channel \
			--add edison-all type=rpm-md name="Edison Package Repository (all)" \
			baseurl=${FEED_URL}/repo/rpm/all -y
		smart	--data-dir=${IMAGE_ROOTFS}/var/lib/smart channel \
			--add edison-core2-32 type=rpm-md name="Edison Package Repository (core2-32)" \
			baseurl=${FEED_URL}/repo/rpm/core2_32 -y
		smart	--data-dir=${IMAGE_ROOTFS}/var/lib/smart channel \
			--add edison-machine type=rpm-md name="Edison Package Repository (edison-machine)" \
			baseurl=${FEED_URL}/repo/rpm/edison -y
	fi
}
```
