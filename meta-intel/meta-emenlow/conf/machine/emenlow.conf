## meta-intel/meta-emenlow/conf/machine/emenlow.conf
```bitbake
#@TYPE: Machine
#@NAME: emenlow

#@WEBTITLE: Intel Atom Z5xx Processor With Intel US15W Controller Hub (eMenlow)

#@DESCRIPTION: Machine configuration for eMenlow based systems, like the
# Webs-2120 box.

PREFERRED_VERSION_linux-yocto ?= "3.10%"

require conf/machine/include/intel-core2-32-common.inc
require conf/machine/include/meta-intel.inc
require conf/machine/include/meta-intel-emgd.inc

MACHINE_FEATURES += "va-impl-mixvideo"

MACHINE_HWCODECS ?= "va-intel"
XSERVERCODECS ?= "emgd-driver-video emgd-gst-plugins-va \
                  emgd-gst-plugins-mixvideo gst-va-intel"

XSERVER ?= "${XSERVER_X86_BASE} \
           ${XSERVER_X86_EXT} \
           ${XSERVER_X86_EMGD} \
           "

PREFERRED_VERSION_xserver-xorg ?= "1.9.3"
PREFERRED_VERSION_xf86-input-synaptics ?= "1.6.3"
PREFERRED_VERSION_xf86-input-evdev ?= "2.6.0"
PREFERRED_VERSION_emgd-driver-bin ?= "1.18"
PREFERRED_VERSION_libva ?= "1.0.16"

APPEND += "video=vesafb vga=0x318 vmalloc=256MB reboot=pci"
```

## meta-intel/meta-fishriver/conf/layer.conf
```bitbake
# We have a conf and classes directory, add to BBPATH
BBPATH := "${BBPATH}:${LAYERDIR}"

# We have a recipes directory, add to BBFILES
BBFILES := "${BBFILES} ${LAYERDIR}/recipes-*/*/*.bb \
	${LAYERDIR}/recipes-*/*/*.bbappend"

BBFILE_COLLECTIONS_fishriver += "fishriver"
BBFILE_PATTERN_fishriver := "^${LAYERDIR}/"
BBFILE_PRIORITY_fishriver = "6"
```

## meta-intel/meta-fishriver/conf/machine/fishriver.conf
```bitbake
#@TYPE: Machine
#@NAME: fishriver

#@DESCRIPTION: Machine configuration for Fish River Island systems
# i.e. Z530/E660 + EG20T

PREFERRED_VERSION_linux-yocto ?= "3.4%"

require conf/machine/include/tune-atom.inc
require conf/machine/include/ia32-base.inc

XSERVER ?= "${XSERVER_IA32_BASE} \
           ${XSERVER_IA32_EXT} \
           ${XSERVER_IA32_VESA} \
           "

APPEND += "video=vesafb vga=0x318"
```

## meta-intel/meta-fri2/conf/layer.conf
```bitbake
# We have a conf and classes directory, add to BBPATH
BBPATH := "${BBPATH}:${LAYERDIR}"

# We have a recipes directory, add to BBFILES
BBFILES := "${BBFILES} ${LAYERDIR}/recipes-*/*/*.bb \
	${LAYERDIR}/recipes-*/*/*.bbappend"

BBFILE_COLLECTIONS += "fri2"
BBFILE_PATTERN_fri2 := "^${LAYERDIR}/"
BBFILE_PRIORITY_fri2 = "6"

LAYERDEPENDS_fri2 = "intel"
```

## meta-intel/meta-fri2/conf/machine/fri2-noemgd.conf
```bitbake
#@TYPE: Machine
#@NAME: fri2

#@WEBTITLE: Intel Atom E640T Processor with Intel EG20T Controller Hub Development Kit (Queens Bay) with Open Source VESA Graphics for Fish River Island II systems

#@DESCRIPTION: Machine configuration for Fish River Island II systems, without Intel-proprietary graphics bits

require conf/machine/include/intel-core2-32-common.inc
require conf/machine/include/intel-common-pkgarch.inc
require conf/machine/include/meta-intel.inc

MACHINE_FEATURES += "wifi 3g pcbios efi"
MACHINE_EXTRA_RRECOMMENDS += "linux-firmware-iwlwifi-6000g2a-5"

PREFERRED_PROVIDER_virtual/kernel ?= "linux-yocto"
PREFERRED_VERSION_linux-yocto ?= "3.14%"

XSERVER ?= "${XSERVER_X86_BASE} \
           ${XSERVER_X86_EXT} \
           ${XSERVER_X86_FBDEV} \
           "

# Syslinux does not know about the 64MHz uart clock and it does not detect the
# serial device by number. Use the IO port directly and divide the baud down to
# trick syslinux into configuring a 115200 baud.
SYSLINUX_OPTS = "serial 0xb060 3318"
SERIAL_CONSOLE = "115200 ttyPCH1"
APPEND += "console=ttyPCH1,115200 console=tty0"

# EFI boot will ignore this and use the EFI framebuffer at 800x600
APPEND += "video=vesafb vga=0x318"

# MSI interrupts fail for the HDA device when using the EFI firmware
APPEND += "snd_hda_intel.enable_msi=0"
```

## meta-intel/meta-fri2/conf/machine/fri2.conf
```bitbake
#@TYPE: Machine
#@NAME: fri2

#@DESCRIPTION: Machine configuration for Fish River Island II systems
# i.e. E660 + EG20T

require conf/machine/include/tune-atom.inc
require conf/machine/include/ia32-base.inc

MACHINE_FEATURES += "wifi 3g pcbios efi"
MACHINE_EXTRA_RRECOMMENDS += "linux-firmware-iwlwifi-6000g2a-5"

PREFERRED_PROVIDER_virtual/kernel ?= "linux-yocto"
PREFERRED_VERSION_linux-yocto = "3.2%"

XSERVER ?= "${XSERVER_IA32_BASE} \
           ${XSERVER_IA32_EXT} \
           ${XSERVER_IA32_EMGD} \
           "

PREFERRED_VERSION_xserver-xorg ?= "1.9.3"
PREFERRED_VERSION_mesa-dri ?= "7.11"
PREFERRED_VERSION_xf86-input-evdev ?= "2.6.0"

# Syslinux does not know about the 64MHz uart clock and it does not detect the
# serial device by number. Use the IO port directly and divide the baud down to
# trick syslinux into configuring a 115200 baud.
SYSLINUX_OPTS = "serial 0xb060 3318"
SERIAL_CONSOLE = "115200 ttyPCH1"
APPEND += "console=ttyPCH1,115200 console=tty0"

# EFI boot will ignore this and use the EFI framebuffer at 800x600
APPEND += "video=vesafb vga=0x318"
```

## meta-intel/meta-isg/conf/layer.conf
```bitbake
# We have a conf and classes directory, add to BBPATH
BBPATH .= ":${LAYERDIR}"

# We have recipes-* directories, add to BBFILES
BBFILES += "${LAYERDIR}/common/recipes-*/*/*.bb \
            ${LAYERDIR}/common/recipes-*/*/*.bbappend"

BBFILE_COLLECTIONS += "isg"
BBFILE_PATTERN_isg := "^${LAYERDIR}/common/"
BBFILE_PRIORITY_isg = "5"

LAYERDEPENDS_isg = "intel"
```

## meta-intel/meta-isg/meta-crystalforest/conf/layer.conf
```bitbake
# We have a conf and classes directory, add to BBPATH
BBPATH .= ":${LAYERDIR}"

# We have a recipes directory, add to BBFILES
BBFILES += "${LAYERDIR}/recipes-*/*/*.bb \
	${LAYERDIR}/recipes-*/*/*.bbappend"

BBFILE_COLLECTIONS += "crystalforest"
BBFILE_PATTERN_crystalforest := "^${LAYERDIR}/"
BBFILE_PRIORITY_crystalforest = "6"

LAYERDEPENDS_crystalforest = "intel"
```

## meta-intel/meta-isg/meta-crystalforest/conf/machine/crystalforest.conf
```bitbake
#@TYPE: Machine
#@NAME: crystalforest

#@WEBTITLE: Intel Xeon E3-1125C/E3-1105C (Formerly Sandy Bridge-Gladden)
#Processors with Intel Communication Chipset 89xx (Crystal Forest Gladden Platform)

#@DESCRIPTION: Machine configuration for Crystal Forest Gladden systems
#for Smaller Form Factor Communication Infrastructure
# i.e. Xeon E3-1125C/E3-1105C + Intel 89xx communication Chipset

#@WEBTITLE: Intel Xeon E5-2600 and E5-2400 (Formerly Sandy Bridge-EP/EN)
#Processors with Intel Communication Chipset 89xx (Crystal Forest Server Platform)

#@DESCRIPTION: Machine configuration for Crystal Forest Server systems
#for Large-Scale Communications Infrastructure
# i.e. Xeon E5-2600 and E5-2400 + Intel 89xx Communication Chipsets

PREFERRED_PROVIDER_virtual/kernel ?= "linux-yocto"
PREFERRED_VERSION_linux-yocto ?= "4.1%"

require conf/machine/include/intel-corei7-64-common.inc
require conf/machine/include/intel-common-pkgarch.inc
require conf/machine/include/meta-intel.inc

XSERVER ?= "${XSERVER_X86_BASE} \
	   ${XSERVER_X86_EXT} \
	   ${XSERVER_X86_MATROX_MGA} \
           "
MACHINE_EXTRA_RRECOMMENDS += "calgary-corpus \
			      canterbury-corpus \
                              "
#This Kernel Option is required for Intel Quick Assist Technology Software.
APPEND += "acpi_enforce_resources=lax"

#Uncomment the below Kernel Option if Virtualization is not needed.
#APPEND += "intel_iommu=off"

SYSLINUX_OPTS = "serial 0 115200"
SERIAL_CONSOLE = "115200 ttyS0"
APPEND += "console=ttyS0,115200 console=tty0"
```

## meta-intel/meta-isg/meta-haswell-wc/conf/layer.conf
```bitbake
# We have a conf and classes directory, add to BBPATH
BBPATH .= ":${LAYERDIR}"

# We have a recipes directory, add to BBFILES
BBFILES += "${LAYERDIR}/recipes-*/*/*.bb \
	${LAYERDIR}/recipes-*/*/*.bbappend"

BBFILE_COLLECTIONS += "haswell-wc"
BBFILE_PATTERN_haswell-wc := "^${LAYERDIR}/"
BBFILE_PRIORITY_haswell-wc = "6"

LAYERDEPENDS_haswell-wc = "intel"
```

## meta-intel/meta-isg/meta-haswell-wc/conf/machine/haswell-wc.conf
```bitbake
#@TYPE: Machine
#@NAME: haswell-wc

#@WEBTITLE: 4th Generation Intel Core Processors with Mobile
# Intel QM87 and HM86 Chipsets (Formerly Shark Bay)

#@DESCRIPTION: Machine configuration for "Walnut Canyon",
# a Shark Bay development kit.

PREFERRED_PROVIDER_virtual/kernel ?= "linux-yocto"
PREFERRED_VERSION_linux-yocto ?= "3.19%"

MACHINE_FEATURES += "pcbios efi va-impl-intel"

require conf/machine/include/intel-corei7-64-common.inc
require conf/machine/include/intel-common-pkgarch.inc
require conf/machine/include/meta-intel.inc

MACHINE_HWCODECS ?= "va-intel gstreamer-vaapi-1.0"

XSERVER ?= "${XSERVER_X86_BASE} \
	    ${XSERVER_X86_EXT} \
	    ${XSERVER_X86_I965} \
	   "

#Since intel-common-standard.scc turn on CONFIG_FB_EFI
#This Kernel Option is required in order to disable FB-EFI
#If not the SATO image will be freezed.
APPEND += "video=efifb:off"
```

## meta-intel/meta-isg/meta-mohonpeak/conf/machine/mohonpeak32.conf
```bitbake
#@TYPE: Machine
#@NAME: mohonpeak 32bit

#@DESCRIPTION: Machine configuration for Mohon Peak systems

PREFERRED_PROVIDER_virtual/kernel ?= "linux-yocto"
PREFERRED_VERSION_linux-yocto ?= "4.1%"

require conf/machine/include/intel-core2-32-common.inc
require conf/machine/include/intel-common-pkgarch.inc
require conf/machine/include/meta-intel.inc

XSERVER ?= "${XSERVER_X86_BASE} \
	   ${XSERVER_X86_EXT} \
	   ${XSERVER_X86_ASPEED_AST} \
           "

MACHINE_FEATURES += "pcbios efi"

SYSLINUX_OPTS = "serial 1 115200"
SERIAL_CONSOLE = "115200 ttyS1"
APPEND += "console=ttyS1,115200 console=tty1"
```

## meta-intel/meta-isg/meta-mohonpeak/conf/machine/mohonpeak64.conf
```bitbake
#@TYPE: Machine
#@NAME: mohonpeak 64 bit

#@DESCRIPTION: Machine configuration for Mohon Peak systems

PREFERRED_PROVIDER_virtual/kernel ?= "linux-yocto"
PREFERRED_VERSION_linux-yocto ?= "4.1%"

require conf/machine/include/intel-corei7-64-common.inc
require conf/machine/include/intel-common-pkgarch.inc
require conf/machine/include/meta-intel.inc

XSERVER ?= "${XSERVER_X86_BASE} \
	   ${XSERVER_X86_EXT} \
	   ${XSERVER_X86_ASPEED_AST} \
	"

MACHINE_FEATURES += "pcbios efi"

SYSLINUX_OPTS = "serial 1 115200"
SERIAL_CONSOLE = "115200 ttyS1"
APPEND += "console=ttyS1,115200 console=tty1"
```

## meta-intel/meta-isg/meta-valleyisland/conf/layer.conf
```bitbake
#We have a conf and classes directory, add to BBPATH
BBPATH .= ":${LAYERDIR}"

# We have a recipes directory, add to BBFILES
BBFILES += "${LAYERDIR}/recipes-*/*/*.bb \
	${LAYERDIR}/recipes-*/*/*.bbappend"

BBFILE_COLLECTIONS += "valleyisland"
BBFILE_PATTERN_valleyisland := "^${LAYERDIR}/"
BBFILE_PRIORITY_valleyisland = "6"

LAYERDEPENDS_valleyisland = "intel"

LICENSE_PATH += "${LAYERDIR}/custom-licenses"
```

## meta-intel/meta-isg/meta-valleyisland/conf/machine/valleyisland-32.conf
```bitbake
#@TYPE: Machine
#@NAME: valleyisland-32

#@WEBTITLE: Intel Atom E38xx Processor (Valley Island) 32-bit with Open Source Frame Buffer Graphics

#@DESCRIPTION: Machine configuration for Valley Island 32-bit systems, without Intel-proprietary graphics bits

PREFERRED_PROVIDER_virtual/kernel ?= "linux-yocto"
PREFERRED_VERSION_linux-yocto ?= "3.14%"

require conf/machine/include/intel-core2-32-common.inc
require conf/machine/include/intel-common-pkgarch.inc
require conf/machine/include/meta-intel.inc

MACHINE_FEATURES += "pcbios efi"

MACHINE_EXTRA_RRECOMMENDS += "linux-firmware"

XSERVER ?= "${XSERVER_X86_BASE} \
            ${XSERVER_X86_EXT} \
            ${XSERVER_X86_FBDEV} \
            ${XSERVER_X86_I965} \
           "

APPEND += "acpi_enforce_resources=lax video=efifb:off vga=0x318"
```

## meta-intel/meta-isg/meta-valleyisland/conf/machine/valleyisland-64.conf
```bitbake
#@TYPE: Machine
#@NAME: valleyisland-64

#@WEBTITLE: Intel Atom E38xx Processor (Valley Island) 64-bit with Open Source Frame Buffer Graphics

#@DESCRIPTION: Machine configuration for Valley Island 64-bit systems, without Intel-proprietary graphics bits


PREFERRED_PROVIDER_virtual/kernel ?= "linux-yocto"
PREFERRED_VERSION_linux-yocto ?= "3.14%"

require conf/machine/include/intel-corei7-64-common.inc
require conf/machine/include/intel-common-pkgarch.inc
require conf/machine/include/meta-intel.inc

MACHINE_FEATURES += "pcbios efi"

MACHINE_EXTRA_RRECOMMENDS += "linux-firmware"

XSERVER ?= "${XSERVER_X86_BASE} \
            ${XSERVER_X86_EXT} \
	    ${XSERVER_X86_FBDEV} \
	    ${XSERVER_X86_I965} \
           "

APPEND += "acpi_enforce_resources=lax video=efifb:off vga=0x318"
```

## meta-intel/meta-jasperforest/conf/layer.conf
```bitbake
# We have a conf and classes directory, add to BBPATH
BBPATH .= ":${LAYERDIR}"

# We have a recipes directory, add to BBFILES
BBFILES += "${LAYERDIR}/recipes-*/*/*.bb \
	${LAYERDIR}/recipes-*/*/*.bbappend"

BBFILE_COLLECTIONS += "jasperforest"
BBFILE_PATTERN_jasperforest := "^${LAYERDIR}/"
BBFILE_PRIORITY_jasperforest = "6"

LAYERDEPENDS_jasperforest = "intel"
```

## meta-intel/meta-jasperforest/conf/machine/jasperforest.conf
```bitbake
#@TYPE: Machine
#@NAME: jasperforest

#@WEBTITLE: Intel Xeon C5500/C3500 Series Processors With Intel 3420 PCH Chipset (Jasper Forest)

#@DESCRIPTION: Machine configuration for Jasper Forest Picket Post
# systems i.e. Xeon C5500/C3500 (Nehalem) + Intel 3420 chipset (Ibex Peak)

PREFERRED_VERSION_linux-yocto ?= "3.19%"

require conf/machine/include/meta-intel.inc
require conf/machine/include/intel-corei7-64-common.inc
require conf/machine/include/intel-common-pkgarch.inc

MACHINE_FEATURES += "intel-ucode"

XSERVER ?= "${XSERVER_X86_BASE} \
           ${XSERVER_X86_EXT} \
           ${XSERVER_X86_VESA} \
           "

APPEND += "video=vesafb vga=0x318"
```

## meta-intel/meta-n450/conf/layer.conf
```bitbake
# We have a conf and classes directory, add to BBPATH
BBPATH .= ":${LAYERDIR}"

# We have recipes-* directories, add to BBFILES
BBFILES += "${LAYERDIR}/recipes-*/*/*.bb \
	${LAYERDIR}/recipes-*/*/*.bbappend"

BBFILE_COLLECTIONS += "n450"
BBFILE_PATTERN_n450 = "^${LAYERDIR}/"
BBFILE_PRIORITY_n450 = "6"

LAYERDEPENDS_n450 = "intel"
```

## meta-intel/meta-n450/conf/machine/n450.conf
```bitbake
#@TYPE: Machine
#@NAME: n450

#@WEBTITLE: Intel Atom N450 Processor with Intel 82801 HM I/O Controller Compute Module (Luna Pier) with Intel Compute Module Mini-ITX Carrier

#@DESCRIPTION: Machine configuration for Intel Embedded Development Board 1-N450

PREFERRED_PROVIDER-virtual/kernel ?= "linux-yocto"
PREFERRED_VERSION_linux-yocto ?= "3.8%"

require conf/machine/include/intel-core2-32-common.inc

XSERVER ?= "${XSERVER_X86_BASE} \
           ${XSERVER_X86_EXT} \
           ${XSERVER_X86_I915} \
           "

SYSLINUX_OPTS = "serial 0 115200"
SERIAL_CONSOLE = "115200 ttyS0" 
APPEND += "console=ttyS0,115200 console=tty0" 
```

## meta-intel/meta-nuc/conf/layer.conf
```bitbake
# We have a conf and classes directory, add to BBPATH
BBPATH .= ":${LAYERDIR}"

# We have a recipes directory, add to BBFILES
BBFILES += "${LAYERDIR}/recipes-*/*/*.bb \
	${LAYERDIR}/recipes-*/*/*.bbappend"

BBFILE_COLLECTIONS += "nuc"
BBFILE_PATTERN_nuc := "^${LAYERDIR}/"
BBFILE_PRIORITY_nuc = "6"
```

## meta-intel/meta-nuc/conf/machine/nuc.conf
```bitbake
#@TYPE: Machine
#@NAME: chiefriver

#@WEBTITLE: Intel Next Unit of Computing (NUC) Model: DC3217IYE

#@DESCRIPTION: Machine configuration for Intel NUC model DC3217IYE
# i.e. Ivy Bridge + Panther Point

PREFERRED_VERSION_linux-yocto ?= "3.19%"
MACHINE_FEATURES += "va-impl-intel wifi efi"
MACHINE_FEATURES += "intel-ucode"

require conf/machine/include/meta-intel.inc
require conf/machine/include/intel-corei7-64-common.inc
require conf/machine/include/intel-common-pkgarch.inc

MACHINE_HWCODECS ?= "va-intel gstreamer-vaapi-1.0"

XSERVER ?= "${XSERVER_X86_BASE} \
           ${XSERVER_X86_EXT} \
           ${XSERVER_X86_I965} \
           "

MACHINE_EXTRA_RRECOMMENDS += "linux-firmware-iwlwifi-6000g2b-6 lms8"

# disable the serial port configuration
SERIAL_CONSOLE = ""
```
