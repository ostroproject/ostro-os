## meta-intel/meta-romley/conf/layer.conf
```bitbake
# We have a conf and classes directory, add to BBPATH
BBPATH := "${BBPATH}:${LAYERDIR}"

# We have a recipes directory, add to BBFILES
BBFILES := "${BBFILES} ${LAYERDIR}/recipes-*/*/*.bb \
	${LAYERDIR}/recipes-*/*/*.bbappend"

BBFILE_COLLECTIONS += "romley"
BBFILE_PATTERN_romley := "^${LAYERDIR}/"
BBFILE_PRIORITY_romley = "6"
```

## meta-intel/meta-romley/conf/machine/romley.conf
```bitbake
#@TYPE: Machine
#@NAME: romley

#@WEBTITLE: Intel Xeon E5-2600 and E5-2400 Series (Formerly Sandy Bridge-EP/EN)
#Processors with Intel C604/C602-J Chipset (Romley-EP/EN Platform)

#@DESCRIPTION: Machine configuration for Romley systems
# i.e. Xeon E5-2600 and E5-2400 + Intel CC604/C602-J


PREFERRED_VERSION_linux-yocto ?= "3.10%"

require conf/machine/include/intel-corei7-64-common.inc
require conf/machine/include/intel-common-pkgarch.inc
require conf/machine/include/meta-intel.inc

XSERVER ?= "${XSERVER_X86_BASE} \
           ${XSERVER_X86_EXT} \
	   ${XSERVER_X86_MATROX_MGA} \
           "
```

## meta-intel/meta-sugarbay/conf/machine/sugarbay.conf
```bitbake
#@TYPE: Machine
#@NAME: sugarbay

#@WEBTITLE: Intel 2nd Generation Core Platforms: Core i3, i5, i7 (Sandy Bridge)

#@DESCRIPTION: Machine configuration for Sugar Bay systems
# i.e. Sandy Bridge + Cougar Point

MACHINE_FEATURES += "va-impl-intel"

PREFERRED_VERSION_linux-yocto ?= "3.17%"

require conf/machine/include/meta-intel.inc
require conf/machine/include/intel-corei7-64-common.inc
require conf/machine/include/intel-common-pkgarch.inc

MACHINE_HWCODECS ?= "va-intel gst-va-intel"

XSERVER ?= "${XSERVER_X86_BASE} \
           ${XSERVER_X86_EXT} \
           ${XSERVER_X86_I965} \
           "
```
